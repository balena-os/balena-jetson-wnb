## layers/meta-balena-jetson/conf/machine/apollo-tx2.conf
```bitbake
#@TYPE: Machine
##@NAME: apollo-tx2
##@DESCRIPTION: Machine configuration for the Apollo TX2

MACHINEOVERRIDES = "jetson-tx2:${MACHINE}"
include conf/machine/jetson-tx2.conf
ODMDATA="0x90000"

MACHINEOVERRIDES := "${@'${MACHINEOVERRIDES}'.replace(':${MACHINE}',':jetson-tx2:${MACHINE}')}"
```

## layers/meta-balena-jetson/conf/machine/wnb-tx2.conf
```bitbake
#@TYPE: Machine
##@NAME: wnb-tx2
##@DESCRIPTION: Machine configuration for the WNB TX2

MACHINEOVERRIDES = "jetson-tx2:${MACHINE}"
include conf/machine/jetson-tx2.conf
ODMDATA="0x90000"
```
